// SPDX-License-Identifier: GPL-2.0-only
/*
 * Copyright (c) Qualcomm Technologies, Inc. and/or its subsidiaries.
 */

#include <arm64/qcom/ipq5332-rdp441-qce2204.dts>

/ {
	chosen {
		stdout-path = "serial0";
	};
};
