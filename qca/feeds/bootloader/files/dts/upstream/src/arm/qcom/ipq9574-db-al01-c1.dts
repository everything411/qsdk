// SPDX-License-Identifier: GPL-2.0-only
/*
 * Copyright (c) Qualcomm Technologies, Inc. and/or its subsidiaries.
 */

#include <arm64/qcom/ipq9574-db-al01-c1.dts>

/ {
	chosen {
		stdout-path = "serial0";
	};
};
