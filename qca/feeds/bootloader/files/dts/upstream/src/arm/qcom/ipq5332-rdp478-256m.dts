// SPDX-License-Identifier: GPL-2.0-only
/*
 * Copyright (c) Qualcomm Technologies, Inc. and/or its subsidiaries.
 */

#include <arm64/qcom/ipq5332-rdp478-256m.dts>

/ {
	chosen {
		stdout-path = "serial0";
	};
};
