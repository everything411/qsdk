// SPDX-License-Identifier: GPL-2.0-only
/*
 * Copyright (c) Qualcomm Technologies, Inc. and/or its subsidiaries.
 */

#include <arm64/qcom/ipq5332-tb-mi05.1.dts>

/ {
	chosen {
		stdout-path = "serial0";
	};
};
