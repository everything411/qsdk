## qca/src/u-boot/configs/ipq5332_tiny_v2_nand32_defconfig
```kconfig
CONFIG_ARM=y
CONFIG_ARCH_IPQSOC=y
CONFIG_ARCH_32BIT_SUPPORT=y
CONFIG_ARM_SMCCC=y
CONFIG_HAS_VBAR=y
CONFIG_SKIP_LOWLEVEL_INIT=y
CONFIG_COUNTER_FREQUENCY=24000000
CONFIG_TARGET_IPQ5332=y
CONFIG_SYS_MALLOC_F_LEN=0x50000
CONFIG_SYS_MALLOC_F=y
CONFIG_SYS_LOAD_ADDR=0x44000000
CONFIG_TEXT_BASE=0x4AE60000
CONFIG_TEXT_SIZE=0xA0000
CONFIG_SMEM_BASE_ADDR=0x4A800000
CONFIG_NR_DRAM_BANKS=1
CONFIG_SMEM=y
CONFIG_SYS_MALLOC_LEN=0xE0000
CONFIG_DM_SERIAL=y
CONFIG_DEFAULT_DEVICE_TREE="ipq5332-default"
CONFIG_LOCALVERSION=""
CONFIG_LOCALVERSION_AUTO=y
CONFIG_CC_OPTIMIZE_FOR_SIZE=y
CONFIG_EXPERT=y
CONFIG_SYS_MALLOC_CLEAR_ON_INIT=y
CONFIG_FIT=y
CONFIG_FIT_VERBOSE=y
CONFIG_OF_LIBFDT=y
CONFIG_OF_LIBFDT_OVERLAY=y
# CONFIG_BOOTSTD_BOOTCOMMAND is not set
# CONFIG_PSCI_RESET is not set
CONFIG_FIRMWARE=y
CONFIG_DM=y
CONFIG_OF_CONTROL=y
CONFIG_FIT_SIGNATURE=n
CONFIG_TOOLS_LIBCRYPTO=y
CONFIG_TOOLS_FIT_RSASSA_PSS=n
CONFIG_TOOLS_FIT_SIGNATURE=n
CONFIG_TOOLS_SHA1=n
CONFIG_TOOLS_SHA256=n
CONFIG_TOOLS_SHA384=n
CONFIG_TOOLS_SHA512=n
CONFIG_SYS_EXTRA_OPTIONS=""
CONFIG_SYS_PROMPT="IPQ5332# "
CONFIG_USE_PREBOOT=y
CONFIG_PREBOOT="crashdump"
CONFIG_USE_BOOTARGS=y
CONFIG_USE_BOOTCOMMAND=y
CONFIG_BOOTCOMMAND="bootipq"
CONFIG_BOOTARGS="console=ttyMSM0,115200n8"
# CONFIG_BOOTSTD is not set
CONFIG_HUSH_PARSER=y
CONFIG_SYS_MAXARGS=64
CONFIG_OF_BOARD_FIXUP=y
CONFIG_STACKPROTECTOR=y
CONFIG_MSM_SMEM=y
CONFIG_SYS_CUSTOM_LDSCRIPT=y
CONFIG_SYS_LDSCRIPT="board/qti/common/u-boot-x32.lds"
CONFIG_OF_LIST="ipq5332-default ipq5332-rdp442 ipq5332-rdp477 ipq5332-rdp477-256m ipq5332-rdp483 ipq5332-rdp446 ipq5332-rdp478 ipq5332-rdp478-256m ipq5332-rdp441 ipq5332-rdp441-qca81xx ipq5332-db-mi02.1 ipq5332-tb-mi03.1 ipq5332-tb-mi05.1 ipq5332-rdp468"
CONFIG_DTB_RESELECT=y
CONFIG_MULTI_DTB_FIT=y
CONFIG_MULTI_DTB_FIT_LZO=y
CONFIG_MULTI_DTB_FIT_DYN_ALLOC=y
CONFIG_MULTI_DTB_FIT_UNCOMPRESS_SZ=0x40000
# CONFIG_CMD_BOOTI is not set
CONFIG_ENV_OVERWRITE=y
CONFIG_CLK=y
CONFIG_PINCTRL=y
# CONFIG_MMC is not set
# CONFIG_EFI_LOADER is not set
CONFIG_IPQ_NAND=y
CONFIG_IPQ_FLASH_PART_FIXUP=y
CONFIG_MSM_GPIO=y
CONFIG_CMD_GPIO=y
CONFIG_GPIO=y
CONFIG_MSM_SERIAL=y
CONFIG_STACK_SIZE=0x80000
CONFIG_SYS_BOOTM_LEN=0x4000000
CONFIG_DM_RESET=y
CONFIG_RAM_NUM_PART_ENTRIES=32
CONFIG_RAM_PART_NAME_LENGTH=16
CONFIG_RESET_QCOM=y
CONFIG_NUM_ALT_PARTITION=16
CONFIG_BOARD_TYPES=y
CONFIG_BOARD_EARLY_INIT_F=y
# CONFIG_IPQ_USB is not set
CONFIG_IPQ_SPI_NOR=y
# CONFIG_SPI_FLASH_USE_4K_SECTORS is not set
CONFIG_ENV_IS_IN_NAND=y
CONFIG_ENV_SIZE=0x40000
CONFIG_ENV_RANGE=0x80000
CONFIG_ENV_OFFSET=0xf00000
CONFIG_SF_DEFAULT_BUS=0
CONFIG_SF_DEFAULT_CS=0
CONFIG_SF_DEFAULT_MODE=0x0
CONFIG_SF_DEFAULT_SPEED=50000000
CONFIG_SYS_RX_ETH_BUFFER=32
CONFIG_TFTP_BLOCKSIZE=1280
# CONFIG_CMD_FLASH is not set
CONFIG_IPQ_TINY=y
# CONFIG_PHY_AQUANTIA is not set
# CONFIG_VERSION_ROLLBACK_PARTITION_INFO is not set
# CONFIG_IPQ_PCIE is not set
# CONFIG_IPQ_I2C is not set
# CONFIG_IPQ_COMPRESSED_CRASHDUMP is not set
# CONFIG_IPQ_CRASHDUMP_TO_USB is not set
# CONFIG_IPQ_CRASHDUMP_TO_MEMORY is not set
# CONFIG_IPQ_CRASHDUMP_TO_NVMEMORY is not set
# CONFIG_IPQ_SMP_CMD_SUPPORT is not set
# CONFIG_I2C is not set
# CONFIG_POWER is not set
# CONFIG_INPUT is not set
# CONFIG_CMD_AES_256 is not set
# CONFIG_CMD_BOOTD is not set
# CONFIG_CMD_ELF is not set
# CONFIG_CMD_IMI is not set
# CONFIG_CMD_MEMTEST is not set
# CONFIG_CMD_NFS is not set
# CONFIG_CMD_PINMUX is not set
# CONFIG_CMD_UBIFS is not set
# CONFIG_BOOTM_NETBSD is not set
# CONFIG_BOOTM_PLAN9 is not set
# CONFIG_BOOTM_RTEMS is not set
# CONFIG_BOOTM_VXWORKS is not set
# CONFIG_LEGACY_IMAGE_FORMAT is not set
# CONFIG_SHA256 is not set
# CONFIG_GZIP is not set
# CONFIG_REGEX is not set
```

## qca/src/u-boot/configs/ipq5424_mmc_defconfig
```kconfig
CONFIG_ARM=y
CONFIG_ARCH_IPQSOC=y
CONFIG_ARCH_64BIT_SUPPORT=y
# CONFIG_ARM64_SUPPORT_AARCH32 is not set
CONFIG_ARM_SMCCC=y
CONFIG_HAS_VBAR=y
CONFIG_SKIP_LOWLEVEL_INIT=y
CONFIG_COUNTER_FREQUENCY=24000000
CONFIG_TARGET_IPQ5424=y
CONFIG_SYS_MALLOC_F_LEN=0x1000
CONFIG_SYS_MALLOC_F=y
CONFIG_SYS_LOAD_ADDR=0x90000000
CONFIG_TEXT_BASE=0x8A380000
CONFIG_TEXT_SIZE=0x180000
CONFIG_SMEM_BASE_ADDR=0x8A800000
CONFIG_NR_DRAM_BANKS=2
CONFIG_SMEM=y
CONFIG_SYS_MALLOC_LEN=0xC0000
CONFIG_DM_SERIAL=y
CONFIG_DEFAULT_DEVICE_TREE="ipq5424-default"
CONFIG_LOCALVERSION=""
CONFIG_LOCALVERSION_AUTO=y
CONFIG_CC_OPTIMIZE_FOR_SIZE=y
CONFIG_EXPERT=y
CONFIG_SYS_MALLOC_CLEAR_ON_INIT=y
CONFIG_FIT=y
CONFIG_FIT_VERBOSE=y
CONFIG_OF_LIBFDT=y
CONFIG_OF_LIBFDT_OVERLAY=y
# CONFIG_BOOTSTD_BOOTCOMMAND is not set
# CONFIG_PSCI_RESET is not set
CONFIG_FIRMWARE=y
CONFIG_DM=y
CONFIG_OF_CONTROL=y
CONFIG_FIT_SIGNATURE=n
CONFIG_TOOLS_LIBCRYPTO=y
CONFIG_TOOLS_FIT_RSASSA_PSS=n
CONFIG_TOOLS_FIT_SIGNATURE=n
CONFIG_TOOLS_SHA1=n
CONFIG_TOOLS_SHA256=n
CONFIG_TOOLS_SHA384=n
CONFIG_TOOLS_SHA512=n
CONFIG_SYS_EXTRA_OPTIONS=""
CONFIG_SYS_PROMPT="IPQ5424# "
CONFIG_USE_PREBOOT=y
CONFIG_PREBOOT="crashdump"
CONFIG_USE_BOOTARGS=y
CONFIG_USE_BOOTCOMMAND=y
CONFIG_BOOTCOMMAND="bootipq"
CONFIG_BOOTARGS="console=ttyMSM0,115200n8"
# CONFIG_BOOTSTD is not set
CONFIG_HUSH_PARSER=y
CONFIG_SYS_MAXARGS=64
CONFIG_OF_BOARD_FIXUP=y
CONFIG_STACKPROTECTOR=y
CONFIG_MSM_SMEM=y
CONFIG_SYS_CUSTOM_LDSCRIPT=y
CONFIG_SYS_LDSCRIPT="board/qti/common/u-boot-x64.lds"
CONFIG_OF_LIST="ipq5424-default ipq5424-emulation ipq5424-rdp464 ipq5424-rdp464-c2 ipq5424-rdp466 ipq5424-rdp466-c2 ipq5424-rdp485 ipq5424-rdp485-c2 ipq5424-rdp487 ipq5424-db-mr01.1"
CONFIG_DTB_RESELECT=y
CONFIG_MULTI_DTB_FIT=y
CONFIG_MULTI_DTB_FIT_LZO=y
CONFIG_MULTI_DTB_FIT_USER_DEFINED_AREA=y
CONFIG_MULTI_DTB_FIT_USER_DEF_ADDR=0x8A500000
CONFIG_MULTI_DTB_FIT_UNCOMPRESS_SZ=0x100000
# CONFIG_CMD_BOOTI is not set
CONFIG_ENV_OVERWRITE=y
CONFIG_CLK=y
CONFIG_PINCTRL=y
CONFIG_IPQ_MMC=y
# CONFIG_EFI_LOADER is not set
CONFIG_EFI_PARTITION_ENTRIES_NUMBERS=32
# CONFIG_DMA is not set
CONFIG_MSM_GPIO=y
CONFIG_CMD_GPIO=y
CONFIG_GPIO=y
CONFIG_QCOM_GENI_SE=y
CONFIG_MSM_GENI_SERIAL=y
CONFIG_STACK_SIZE=0x80000
CONFIG_SYS_BOOTM_LEN=0x4000000
CONFIG_DM_RESET=y
CONFIG_RAM_NUM_PART_ENTRIES=32
CONFIG_RAM_PART_NAME_LENGTH=16
CONFIG_RESET_QCOM=y
CONFIG_NUM_ALT_PARTITION=16
CONFIG_BOARD_TYPES=y
CONFIG_BOARD_EARLY_INIT_F=y
CONFIG_IPQ_SPI_NOR=y
# CONFIG_SPI_FLASH_USE_4K_SECTORS is not set
CONFIG_ENV_IS_IN_MMC=y
CONFIG_SYS_MMC_ENV_PART=0
CONFIG_SUPPORT_EMMC_BOOT=y
CONFIG_ENV_SIZE=0x40000
CONFIG_ENV_RANGE=0x40000
CONFIG_ENV_OFFSET=0
CONFIG_SF_DEFAULT_BUS=0
CONFIG_SF_DEFAULT_CS=0
CONFIG_SF_DEFAULT_MODE=0x0
CONFIG_SF_DEFAULT_SPEED=50000000
CONFIG_SYS_RX_ETH_BUFFER=128
CONFIG_ETH_MAX_MAC=3
CONFIG_ETH_MAX_UNIPHY=3
CONFIG_TFTP_BLOCKSIZE=1280
# CONFIG_CMD_FLASH is not set
# CONFIG_VERSION_ROLLBACK_PARTITION_INFO is not set
# CONFIG_BOARD_EARLY_INIT_R is not set
```

## qca/src/u-boot/configs/ipq9574_mmc32_defconfig
```kconfig
CONFIG_ARM=y
CONFIG_ARCH_IPQSOC=y
CONFIG_ARCH_32BIT_SUPPORT=y
CONFIG_ARM_SMCCC=y
CONFIG_HAS_VBAR=y
CONFIG_SKIP_LOWLEVEL_INIT=y
CONFIG_COUNTER_FREQUENCY=24000000
CONFIG_TARGET_IPQ9574=y
CONFIG_SYS_MALLOC_F_LEN=0x1000
CONFIG_SYS_MALLOC_F=y
CONFIG_SYS_LOAD_ADDR=0x50000000
CONFIG_TEXT_BASE=0x4A240000
CONFIG_SMEM_BASE_ADDR=0x4AA00000
CONFIG_NR_DRAM_BANKS=1
CONFIG_SMEM=y
CONFIG_SYS_MALLOC_LEN=0x1C0000
CONFIG_DM_SERIAL=y
CONFIG_DEFAULT_DEVICE_TREE="ipq9574-default"
CONFIG_LOCALVERSION=""
CONFIG_LOCALVERSION_AUTO=y
CONFIG_CC_OPTIMIZE_FOR_SIZE=y
CONFIG_EXPERT=y
CONFIG_SYS_MALLOC_CLEAR_ON_INIT=y
CONFIG_FIT=y
CONFIG_FIT_VERBOSE=y
CONFIG_OF_LIBFDT=y
CONFIG_OF_LIBFDT_OVERLAY=y
# CONFIG_BOOTSTD_BOOTCOMMAND is not set
# CONFIG_PSCI_RESET is not set
CONFIG_FIRMWARE=y
CONFIG_DM=y
CONFIG_OF_CONTROL=y
CONFIG_FIT_SIGNATURE=n
CONFIG_TOOLS_LIBCRYPTO=y
CONFIG_TOOLS_FIT_RSASSA_PSS=n
CONFIG_TOOLS_FIT_SIGNATURE=n
CONFIG_TOOLS_SHA1=n
CONFIG_TOOLS_SHA256=n
CONFIG_TOOLS_SHA384=n
CONFIG_TOOLS_SHA512=n
CONFIG_SYS_EXTRA_OPTIONS=""
CONFIG_SYS_PROMPT="IPQ9574# "
CONFIG_USE_PREBOOT=y
CONFIG_PREBOOT="crashdump"
CONFIG_USE_BOOTARGS=y
CONFIG_USE_BOOTCOMMAND=y
CONFIG_BOOTCOMMAND="bootipq"
CONFIG_BOOTARGS="console=ttyMSM0,115200n8"
# CONFIG_BOOTSTD is not set
CONFIG_HUSH_PARSER=y
CONFIG_SYS_MAXARGS=64
CONFIG_OF_BOARD_FIXUP=y
CONFIG_STACKPROTECTOR=y
CONFIG_MSM_SMEM=y
CONFIG_SYS_CUSTOM_LDSCRIPT=y
CONFIG_SYS_LDSCRIPT="board/qti/common/u-boot-x32.lds"
CONFIG_OF_LIST="ipq9574-default ipq9574-rdp417 ipq9574-rdp418 ipq9574-rdp433 ipq9574-rdp433-mht-phy ipq9574-rdp433-mht-switch ipq9574-rdp437 ipq9574-rdp454 ipq9574-rdp458 ipq9574-rdp459 ipq9574-rdp461 ipq9574-rdp469 ipq9574-rdp475 ipq9574-rdp475-qca81xx ipq9574-rdp475-qca81xx-i2c ipq9574-rdp476 ipq9574-rdp449 ipq9574-rdp453 ipq9574-rdp455 ipq9574-rdp456 ipq9574-rdp457 ipq9574-rdp467 ipq9574-db-al01-c1 ipq9574-db-al01-c3 ipq9574-db-al02-c1 ipq9574-db-al02-c3 ipq9574-rdp433-sfp"
CONFIG_DTB_RESELECT=y
CONFIG_MULTI_DTB_FIT=y
CONFIG_MULTI_DTB_FIT_LZO=y
CONFIG_MULTI_DTB_FIT_USER_DEFINED_AREA=y
CONFIG_MULTI_DTB_FIT_USER_DEF_ADDR=0x4A400000
CONFIG_MULTI_DTB_FIT_UNCOMPRESS_SZ=0x100000
# CONFIG_CMD_BOOTI is not set
CONFIG_ENV_OVERWRITE=y
CONFIG_CLK=y
CONFIG_PINCTRL=y
CONFIG_IPQ_MMC=y
# CONFIG_EFI_LOADER is not set
# CONFIG_MMC_HS200_SUPPORT is not set
CONFIG_EFI_PARTITION_ENTRIES_NUMBERS=64
CONFIG_MSM_GPIO=y
CONFIG_CMD_GPIO=y
CONFIG_GPIO=y
CONFIG_MSM_SERIAL=y
CONFIG_STACK_SIZE=0x80000
CONFIG_SYS_BOOTM_LEN=0x4000000
CONFIG_DM_RESET=y
CONFIG_RAM_NUM_PART_ENTRIES=32
CONFIG_RAM_PART_NAME_LENGTH=16
CONFIG_RESET_QCOM=y
CONFIG_NUM_ALT_PARTITION=16
CONFIG_BOARD_TYPES=y
CONFIG_BOARD_EARLY_INIT_F=y
CONFIG_IPQ_USB=y
CONFIG_IPQ_SPI_NOR=y
# CONFIG_SPI_FLASH_USE_4K_SECTORS is not set
CONFIG_ENV_IS_IN_MMC=y
CONFIG_SYS_MMC_ENV_PART=0
CONFIG_ENV_SIZE=0x40000
CONFIG_ENV_RANGE=0x40000
CONFIG_ENV_OFFSET=0
CONFIG_SF_DEFAULT_BUS=0
CONFIG_SF_DEFAULT_CS=0
CONFIG_SF_DEFAULT_MODE=0x0
CONFIG_SF_DEFAULT_SPEED=50000000
CONFIG_SYS_RX_ETH_BUFFER=128
CONFIG_ETH_MAX_MAC=6
CONFIG_ETH_MAX_UNIPHY=3
CONFIG_TFTP_BLOCKSIZE=1280
# CONFIG_CMD_FLASH is not set
```

## qca/src/wlan-open-extns/ath/ath12k/src/Kconfig
```kconfig
config QCN_EXTN
	bool "Enable QCN extensions support"
	depends on ATH12K
	default y
	help
	  Select this option to enable QCN 802.11 extensions in ath12k
	  drivers that support it..

config QCA_LAB_TEST_FEATURES
	bool "Enable QCA lab test features"
	depends on QCN_EXTN
	default y
	help
	  Select this option to enable ath12k lab-only debug. This is
	  intended only for QCN lab test purpose and not for production
	  builds as it may overrides regulatory requirements.

config QCN_EXTN_MESH_SUPPORT
	bool "Enable QCN extensions mesh feature support"
	depends on QCN_EXTN
	default n
	help
	  Select this option to enable QCN extension mesh feature in ath12k
	  drivers that support it..
```
