## qca/feeds/bootloader/files/configs/ipq5210_mmc32_defconfig
```kconfig
CONFIG_ARM=y
CONFIG_ARCH_IPQ=y
CONFIG_ARCH_32BIT_SUPPORT=y
CONFIG_ARM_SMCCC=y
CONFIG_HAS_VBAR=y
CONFIG_SYS_BOARD="ipq5210"
CONFIG_SYS_CONFIG_NAME="ipq5210"
CONFIG_SYS_PROMPT="IPQ5210# "
CONFIG_TARGET_IPQ5210=y
CONFIG_SKIP_LOWLEVEL_INIT=y
CONFIG_NR_DRAM_BANKS=1
CONFIG_TEXT_BASE=0x80280000
CONFIG_TEXT_SIZE=0x180000
CONFIG_SYS_LOAD_ADDR=0x90000000
CONFIG_DEFAULT_DEVICE_TREE="ipq5210-emulation"
CONFIG_FIT=y
CONFIG_FIT_VERBOSE=y
CONFIG_BOOTDELAY=2
CONFIG_OF_BOARD_SETUP=y
CONFIG_SYS_CBSIZE=1024
# CONFIG_EFI_LOADER is not set
CONFIG_MSM_GPIO=y
CONFIG_CLK_QCOM_IPQ5210=y
CONFIG_PINCTRL_QCOM_IPQ5210=y
CONFIG_MSM_GENI_SERIAL=y
CONFIG_BOARD_EARLY_INIT_F=y
CONFIG_PINCONF=y
CONFIG_IPQ_MMC=y
# CONFIG_PRPL_MMC_LABEL is not set
CONFIG_ENV_IS_IN_MMC=y
CONFIG_ENV_OVERWRITE=y
CONFIG_USE_ENV_MMC_PARTITION=y
CONFIG_SYS_MMC_ENV_PART=0
CONFIG_ENV_MMC_PARTITION="0:APPSBLENV"
CONFIG_ENV_OFFSET=0
CONFIG_ENV_SIZE=0x40000
CONFIG_ENV_RANGE=0x40000
# CONFIG_PSCI_RESET is not set
CONFIG_USE_PREBOOT=y
CONFIG_PREBOOT="crashdump"
CONFIG_BOOTCOMMAND="bootipq"
CONFIG_USE_BOOTARGS=y
CONFIG_BOOTARGS="console=ttyMSM0,115200n8"
# CONFIG_DISPLAY_CPUINFO is not set
CONFIG_BOARD_EARLY_INIT_R=y
CONFIG_SYS_MALLOC_F=y
CONFIG_SYS_MALLOC_F_LEN=0x40000
CONFIG_SYS_MALLOC_LEN=0xC0000
CONFIG_STACK_SIZE=0x80000
CONFIG_LZMA=y
CONFIG_ETH_MAX_UNIPHY=3
CONFIG_SYS_RX_ETH_BUFFER=128
CONFIG_TFTP_BLOCKSIZE=1280
CONFIG_PHY_ANEG_TIMEOUT=100
# CONFIG_CMD_BOOTI is not set
CONFIG_SUPPORT_EMMC_BOOT=y
CONFIG_OF_BOARD_FIXUP=y
# CONFIG_BOOTSTD is not set
# CONFIG_DDR_SI_TEST is not set
# CONFIG_LEGACY_HASHING_AND_CRYPTO is not set
# CONFIG_CMD_ELF_BOOTVX is not set
# CONFIG_SHA1_LEGACY is not set
CONFIG_COUNTER_FREQUENCY=24000000
CONFIG_USE_BOOTCOMMAND=y
# CONFIG_OF_UPSTREAM is not set
CONFIG_IPQ_SPI_NOR=y
# CONFIG_ENV_IS_NOWHERE is not set
# CONFIG_FDT_FIXUP_PARTITIONS is not set
CONFIG_IPQ_DYNAMIC_RELOCATION=y
```

## qca/feeds/bootloader/files/configs/ipq5210_nand32_defconfig
```kconfig
CONFIG_ARM=y
CONFIG_ARCH_IPQ=y
CONFIG_ARCH_32BIT_SUPPORT=y
CONFIG_ARM_SMCCC=y
CONFIG_HAS_VBAR=y
CONFIG_SYS_BOARD="ipq5210"
CONFIG_SYS_CONFIG_NAME="ipq5210"
CONFIG_SYS_PROMPT="IPQ5210# "
CONFIG_TARGET_IPQ5210=y
CONFIG_SKIP_LOWLEVEL_INIT=y
CONFIG_TEXT_BASE=0x80280000
CONFIG_COUNTER_FREQUENCY=24000000
CONFIG_SYS_MALLOC_F_LEN=0x40000
CONFIG_SYS_MALLOC_F=y
CONFIG_SYS_LOAD_ADDR=0x90000000
CONFIG_TEXT_SIZE=0x180000
CONFIG_SMEM_BASE_ADDR=0x8A800000
CONFIG_NR_DRAM_BANKS=1
CONFIG_SYS_MALLOC_LEN=0xC0000
CONFIG_LOCALVERSION=""
CONFIG_LOCALVERSION_AUTO=y
CONFIG_DEFAULT_DEVICE_TREE="ipq5210-emulation"
CONFIG_CC_OPTIMIZE_FOR_SIZE=y
CONFIG_EXPERT=y
CONFIG_SYS_MALLOC_CLEAR_ON_INIT=y
CONFIG_FIT=y
CONFIG_FIT_VERBOSE=y
CONFIG_OF_LIBFDT=y
# CONFIG_BOOTSTD_BOOTCOMMAND is not set
# CONFIG_PSCI_RESET is not set
CONFIG_FIRMWARE=y
CONFIG_FIT_SIGNATURE=n
CONFIG_TOOLS_LIBCRYPTO=y
CONFIG_TOOLS_FIT_RSASSA_PSS=n
CONFIG_TOOLS_FIT_SIGNATURE=n
CONFIG_TOOLS_SHA1=n
CONFIG_TOOLS_SHA256=n
CONFIG_TOOLS_SHA384=n
CONFIG_TOOLS_SHA512=n
CONFIG_SYS_EXTRA_OPTIONS=""
CONFIG_USE_PREBOOT=y
CONFIG_PREBOOT="crashdump"
CONFIG_USE_BOOTARGS=y
CONFIG_USE_BOOTCOMMAND=y
CONFIG_BOOTCOMMAND="bootipq"
CONFIG_BOOTARGS="console=ttyMSM0,115200n8"
# CONFIG_BOOTSTD is not set
CONFIG_HUSH_PARSER=y
CONFIG_SYS_MAXARGS=64
CONFIG_STACKPROTECTOR=y
CONFIG_MSM_SMEM=y
# CONFIG_CMD_BOOTI is not set
CONFIG_ENV_OVERWRITE=y
# CONFIG_MMC is not set
# CONFIG_EFI_LOADER is not set
CONFIG_IPQ_NAND=y
CONFIG_IPQ_FLASH_PART_FIXUP=y
# CONFIG_CMD_UBIFS is not set
CONFIG_MSM_GPIO=y
CONFIG_CMD_GPIO=y
CONFIG_GPIO=y
CONFIG_QCOM_GENI_SE=y
CONFIG_MSM_GENI_SERIAL=y
CONFIG_STACK_SIZE=0x80000
CONFIG_SYS_BOOTM_LEN=0x4000000
CONFIG_RAM_NUM_PART_ENTRIES=32
CONFIG_RAM_PART_NAME_LENGTH=16
CONFIG_RESET_QCOM=y
CONFIG_NUM_ALT_PARTITION=16
CONFIG_BOARD_TYPES=y
CONFIG_BOARD_EARLY_INIT_F=y
CONFIG_IPQ_SPI_NOR=y
# CONFIG_SPI_FLASH_USE_4K_SECTORS is not set
CONFIG_ENV_IS_IN_NAND=y
CONFIG_ENV_SIZE=0x40000
CONFIG_ENV_RANGE=0x80000
CONFIG_ENV_OFFSET=0x11c0000
CONFIG_SF_DEFAULT_BUS=0
CONFIG_SF_DEFAULT_CS=0
CONFIG_SF_DEFAULT_MODE=0x0
CONFIG_SF_DEFAULT_SPEED=50000000
# CONFIG_VERSION_ROLLBACK_PARTITION_INFO is not set
CONFIG_BOOTDELAY=2
CONFIG_OF_BOARD_SETUP=y
CONFIG_SYS_CBSIZE=1024
CONFIG_CLK_QCOM_IPQ5210=y
CONFIG_PINCTRL_QCOM_IPQ5210=y
CONFIG_PINCONF=y
# CONFIG_ENV_IS_IN_SPI_FLASH is not set
CONFIG_BOARD_EARLY_INIT_R=y
CONFIG_LZMA=y
CONFIG_QSPI_SERIAL_TRAINING=y
CONFIG_PAGE_SCOPE_MULTI_PAGE_READ=y
CONFIG_DMA=y

# CONFIG_CMD_MMC is not set
# CONFIG_DISPLAY_CPUINFO is not set

CONFIG_OF_BOARD_FIXUP=y
# CONFIG_DDR_SI_TEST is not set
# CONFIG_LEGACY_HASHING_AND_CRYPTO is not set
# CONFIG_CMD_ELF_BOOTVX is not set
# CONFIG_SHA1_LEGACY is not set
# CONFIG_OF_UPSTREAM is not set
CONFIG_ETH_MAX_UNIPHY=3
CONFIG_SYS_RX_ETH_BUFFER=128
CONFIG_TFTP_BLOCKSIZE=1280
CONFIG_PHY_ANEG_TIMEOUT=100
CONFIG_IPQ_DYNAMIC_RELOCATION=y
```

## qca/feeds/bootloader/files/configs/ipq5210_norplusmmc32_defconfig
```kconfig
CONFIG_ARM=y
CONFIG_ARCH_IPQ=y
CONFIG_ARCH_32BIT_SUPPORT=y
CONFIG_ARM_SMCCC=y
CONFIG_SYS_BOARD="ipq5210"
CONFIG_SYS_CONFIG_NAME="ipq5210"
CONFIG_SYS_PROMPT="IPQ5210# "
CONFIG_TARGET_IPQ5210=y
CONFIG_SKIP_LOWLEVEL_INIT=y
CONFIG_NR_DRAM_BANKS=1
CONFIG_TEXT_BASE=0x80280000
CONFIG_TEXT_SIZE=0x180000
CONFIG_SYS_LOAD_ADDR=0x90000000
CONFIG_SYS_MALLOC_LEN=0xF0000
CONFIG_STACK_SIZE=0x80000
CONFIG_DEFAULT_DEVICE_TREE="ipq5210-emulation"
CONFIG_FIT=y
CONFIG_FIT_VERBOSE=y
CONFIG_BOOTDELAY=2
CONFIG_OF_BOARD_SETUP=y
CONFIG_SYS_CBSIZE=1024
# CONFIG_DISPLAY_CPUINFO is not set
# CONFIG_EFI_LOADER is not set
CONFIG_MSM_GPIO=y
CONFIG_CLK_QCOM_IPQ5210=y
CONFIG_PINCTRL_QCOM_IPQ5210=y
CONFIG_MSM_GENI_SERIAL=y
CONFIG_BOARD_EARLY_INIT_F=y
CONFIG_PINCONF=y
CONFIG_IPQ_MMC=y
CONFIG_USE_PREBOOT=y
CONFIG_PREBOOT="crashdump"
# CONFIG_PRPL_MMC_LABEL is not set
CONFIG_SF_DEFAULT_BUS=0
CONFIG_SF_DEFAULT_CS=0
CONFIG_SF_DEFAULT_MODE=0x0
CONFIG_SF_DEFAULT_SPEED=50000000
CONFIG_RUNTIME_SF_ENV_UPDATE=y
# CONFIG_SPI_FLASH_USE_4K_SECTORS is not set
CONFIG_ENV_IS_IN_SPI_FLASH=y
CONFIG_ENV_OVERWRITE=y
CONFIG_ENV_OFFSET=0xBD0000
CONFIG_ENV_SIZE=0x10000
CONFIG_ENV_RANGE=0x10000
CONFIG_ENV_SECT_SIZE=0x10000
# CONFIG_PSCI_RESET is not set
CONFIG_IPQ_SPI_NOR=y
# CONFIG_CMD_BOOTI is not set
CONFIG_BOARD_EARLY_INIT_R=y
CONFIG_SYS_MALLOC_F=y
CONFIG_SYS_MALLOC_F_LEN=0x40000
CONFIG_LZMA=y
CONFIG_SUPPORT_EMMC_BOOT=y
CONFIG_ETH_MAX_UNIPHY=3
CONFIG_SYS_RX_ETH_BUFFER=128
CONFIG_TFTP_BLOCKSIZE=1280
CONFIG_PHY_ANEG_TIMEOUT=100
CONFIG_OF_BOARD_FIXUP=y
CONFIG_USE_BOOTARGS=y
CONFIG_BOOTARGS="console=ttyMSM0,115200n8"
CONFIG_BOOTCOMMAND="bootipq"
# CONFIG_BOOTSTD is not set
# CONFIG_DDR_SI_TEST is not set
# CONFIG_LEGACY_HASHING_AND_CRYPTO is not set
# CONFIG_CMD_ELF_BOOTVX is not set
# CONFIG_SHA1_LEGACY is not set
CONFIG_COUNTER_FREQUENCY=24000000
CONFIG_USE_BOOTCOMMAND=y
# CONFIG_OF_UPSTREAM is not set
# CONFIG_ENV_IS_NOWHERE is not set
CONFIG_HAS_VBAR=y
CONFIG_IPQ_DYNAMIC_RELOCATION=y
```

## qca/feeds/bootloader/files/configs/ipq5332_norplusmmc32_defconfig
```kconfig
CONFIG_ARM=y
CONFIG_ARCH_IPQ=y
CONFIG_ARCH_32BIT_SUPPORT=y
CONFIG_ARM_SMCCC=y
CONFIG_HAS_VBAR=y
CONFIG_SYS_BOARD="ipq5332"
CONFIG_SYS_CONFIG_NAME="ipq5332"
CONFIG_SYS_PROMPT="IPQ5332# "
CONFIG_TARGET_IPQ5332=y
CONFIG_SKIP_LOWLEVEL_INIT=y
CONFIG_NR_DRAM_BANKS=1
CONFIG_TEXT_BASE=0x4A280000
CONFIG_TEXT_SIZE=0x180000
CONFIG_SYS_LOAD_ADDR=0x50000000
CONFIG_DEVICE_TREE_INCLUDES="ipq5332-u-boot.dtsi"
CONFIG_DEFAULT_DEVICE_TREE="qcom/ipq5332-rdp468"
CONFIG_OF_LIST="qcom/ipq5332-db-mi01.1 qcom/ipq5332-db-mi02.1 qcom/ipq5332-db-mi03.1 qcom/ipq5332-rdp441 qcom/ipq5332-rdp441-qca81xx qcom/ipq5332-rdp441-qca81xx-i2c qcom/ipq5332-rdp441-qce2204 qcom/ipq5332-rdp442 qcom/ipq5332-rdp446 qcom/ipq5332-rdp468 qcom/ipq5332-rdp472 qcom/ipq5332-rdp474 qcom/ipq5332-rdp477-256m qcom/ipq5332-rdp477 qcom/ipq5332-rdp478-256m qcom/ipq5332-rdp478 qcom/ipq5332-rdp479 qcom/ipq5332-rdp480 qcom/ipq5332-rdp481 qcom/ipq5332-rdp483 qcom/ipq5332-rdp484 qcom/ipq5332-rdp494 qcom/ipq5332-rdp509 qcom/ipq5332-tb-mi03.1 qcom/ipq5332-tb-mi05.1"
CONFIG_FIT=y
CONFIG_FIT_VERBOSE=y
CONFIG_BOOTDELAY=2
CONFIG_OF_BOARD_SETUP=y
CONFIG_SYS_CBSIZE=1024
# CONFIG_DISPLAY_CPUINFO is not set
# CONFIG_EFI_LOADER is not set
CONFIG_MSM_GPIO=y
CONFIG_CLK_QCOM_IPQ5332=y
CONFIG_PINCTRL_QCOM_IPQ5332=y
CONFIG_MSM_SERIAL=y
CONFIG_BOARD_EARLY_INIT_F=y
CONFIG_PINCONF=y
CONFIG_IPQ_MMC=y
# CONFIG_PRPL_MMC_LABEL is not set
CONFIG_SF_DEFAULT_BUS=0
CONFIG_SF_DEFAULT_CS=0
CONFIG_SF_DEFAULT_MODE=0x0
CONFIG_SF_DEFAULT_SPEED=50000000
# CONFIG_SPI_FLASH_USE_4K_SECTORS is not set
CONFIG_ENV_IS_IN_SPI_FLASH=y
CONFIG_ENV_OVERWRITE=y
CONFIG_ENV_OFFSET=0x250000
CONFIG_ENV_SIZE=0x10000
CONFIG_ENV_RANGE=0x10000
CONFIG_ENV_SECT_SIZE=0x10000
# CONFIG_PSCI_RESET is not set
CONFIG_USE_PREBOOT=y
CONFIG_PREBOOT="crashdump"
CONFIG_IPQ_SPI_NOR=y
# CONFIG_CMD_BOOTI is not set
CONFIG_BOARD_EARLY_INIT_R=y
CONFIG_MULTI_DTB_FIT=y
CONFIG_MULTI_DTB_FIT_LZO=y
CONFIG_SYS_MALLOC_F=y
CONFIG_SYS_MALLOC_F_LEN=0x40000
CONFIG_DTB_RESELECT=y
CONFIG_SYS_MALLOC_LEN=0xF0000
CONFIG_LZMA=y
CONFIG_MULTI_DTB_FIT_USER_DEFINED_AREA=y
CONFIG_MULTI_DTB_FIT_USER_DEF_ADDR=0x4A400000
CONFIG_MULTI_DTB_FIT_UNCOMPRESS_SZ=0x100000
CONFIG_ETH_MAX_MAC=2
CONFIG_ETH_MAX_UNIPHY=2
CONFIG_SYS_RX_ETH_BUFFER=128
CONFIG_TFTP_BLOCKSIZE=1280
CONFIG_PHY_ANEG_TIMEOUT=100
CONFIG_OF_BOARD_FIXUP=y
CONFIG_USE_BOOTARGS=y
CONFIG_BOOTARGS="console=ttyMSM0,115200n8"
CONFIG_USE_BOOTCOMMAND=y
CONFIG_BOOTCOMMAND="bootipq"
# CONFIG_DDR_SI_TEST is not set
# CONFIG_LEGACY_HASHING_AND_CRYPTO is not set
# CONFIG_CMD_ELF_BOOTVX is not set
CONFIG_COUNTER_FREQUENCY=24000000
# CONFIG_BOOTSTD is not set
# CONFIG_SHA1_LEGACY is not set
```

## qca/feeds/bootloader/files/configs/ipq5332_norplusnand32_defconfig
```kconfig
CONFIG_ARM=y
CONFIG_ARCH_IPQ=y
CONFIG_ARCH_32BIT_SUPPORT=y
# CONFIG_ARM64_SUPPORT_AARCH32 is not set
CONFIG_ARM_SMCCC=y
CONFIG_HAS_VBAR=y
CONFIG_SYS_BOARD="ipq5332"
CONFIG_SYS_CONFIG_NAME="ipq5332"
CONFIG_SYS_PROMPT="IPQ5332# "
CONFIG_TARGET_IPQ5332=y
CONFIG_SKIP_LOWLEVEL_INIT=y
CONFIG_COUNTER_FREQUENCY=24000000
CONFIG_SYS_MALLOC_F_LEN=0x40000
CONFIG_SYS_MALLOC_F=y
CONFIG_SYS_LOAD_ADDR=0x50000000
CONFIG_TEXT_BASE=0x4A280000
CONFIG_TEXT_SIZE=0x180000
CONFIG_SMEM_BASE_ADDR=0x4A800000
CONFIG_NR_DRAM_BANKS=1
CONFIG_SMEM=y
CONFIG_SYS_MALLOC_LEN=0xF0000
CONFIG_DM_SERIAL=y
CONFIG_LOCALVERSION=""
CONFIG_LOCALVERSION_AUTO=y
CONFIG_CC_OPTIMIZE_FOR_SIZE=y
CONFIG_EXPERT=y
CONFIG_SYS_MALLOC_CLEAR_ON_INIT=y
CONFIG_DEVICE_TREE_INCLUDES="ipq5332-u-boot.dtsi"
CONFIG_DEFAULT_DEVICE_TREE="qcom/ipq5332-rdp468"
CONFIG_OF_LIST="qcom/ipq5332-db-mi01.1 qcom/ipq5332-db-mi02.1 qcom/ipq5332-db-mi03.1 qcom/ipq5332-rdp441 qcom/ipq5332-rdp441-qca81xx qcom/ipq5332-rdp441-qca81xx-i2c qcom/ipq5332-rdp441-qce2204 qcom/ipq5332-rdp442 qcom/ipq5332-rdp446 qcom/ipq5332-rdp468 qcom/ipq5332-rdp472 qcom/ipq5332-rdp474 qcom/ipq5332-rdp477-256m qcom/ipq5332-rdp477 qcom/ipq5332-rdp478-256m qcom/ipq5332-rdp478 qcom/ipq5332-rdp479 qcom/ipq5332-rdp480 qcom/ipq5332-rdp481 qcom/ipq5332-rdp483 qcom/ipq5332-rdp484 qcom/ipq5332-rdp494 qcom/ipq5332-rdp509 qcom/ipq5332-tb-mi03.1 qcom/ipq5332-tb-mi05.1"
CONFIG_FIT=y
CONFIG_FIT_VERBOSE=y
CONFIG_OF_LIBFDT=y
# CONFIG_BOOTSTD_BOOTCOMMAND is not set
# CONFIG_PSCI_RESET is not set
CONFIG_FIRMWARE=y
CONFIG_DM=y
CONFIG_OF_CONTROL=y
CONFIG_FIT_SIGNATURE=n
CONFIG_TOOLS_LIBCRYPTO=y
CONFIG_TOOLS_FIT_RSASSA_PSS=n
CONFIG_TOOLS_FIT_SIGNATURE=n
CONFIG_TOOLS_SHA1=n
CONFIG_TOOLS_SHA256=n
CONFIG_TOOLS_SHA384=n
CONFIG_TOOLS_SHA512=n
CONFIG_SYS_EXTRA_OPTIONS=""
CONFIG_USE_PREBOOT=y
CONFIG_PREBOOT="crashdump"
CONFIG_USE_BOOTARGS=y
CONFIG_USE_BOOTCOMMAND=y
CONFIG_BOOTCOMMAND="bootipq"
CONFIG_BOOTARGS="console=ttyMSM0,115200n8"
# CONFIG_BOOTSTD is not set
CONFIG_HUSH_PARSER=y
CONFIG_SYS_MAXARGS=64
CONFIG_STACKPROTECTOR=y
CONFIG_MSM_SMEM=y
CONFIG_DTB_RESELECT=y
CONFIG_MULTI_DTB_FIT=y
CONFIG_MULTI_DTB_FIT_LZO=y
CONFIG_MULTI_DTB_FIT_USER_DEFINED_AREA=y
CONFIG_MULTI_DTB_FIT_USER_DEF_ADDR=0x4A400000
CONFIG_MULTI_DTB_FIT_UNCOMPRESS_SZ=0x100000
# CONFIG_CMD_BOOTI is not set
CONFIG_ENV_OVERWRITE=y
CONFIG_CLK=y
CONFIG_PINCTRL=y
# CONFIG_MMC is not set
# CONFIG_EFI_LOADER is not set
CONFIG_IPQ_NAND=y
CONFIG_IPQ_FLASH_PART_FIXUP=y
CONFIG_BOOTSTD_FULL=y
CONFIG_BOOTDELAY=2
CONFIG_OF_BOARD_SETUP=y
CONFIG_SYS_CBSIZE=1024
CONFIG_MSM_GPIO=y
CONFIG_CMD_GPIO=y
CONFIG_GPIO=y
CONFIG_CLK_QCOM_IPQ5332=y
CONFIG_PINCTRL_QCOM_IPQ5332=y
CONFIG_MSM_SERIAL=y
CONFIG_STACK_SIZE=0x80000
CONFIG_SYS_BOOTM_LEN=0x4000000
CONFIG_DM_RESET=y
CONFIG_RAM_NUM_PART_ENTRIES=32
CONFIG_RAM_PART_NAME_LENGTH=16
CONFIG_RESET_QCOM=y
CONFIG_NUM_ALT_PARTITION=16
CONFIG_BOARD_TYPES=y
CONFIG_BOARD_EARLY_INIT_F=y
CONFIG_PINCONF=y
CONFIG_SF_DEFAULT_BUS=0
CONFIG_SF_DEFAULT_CS=0
CONFIG_SF_DEFAULT_MODE=0x0
CONFIG_SF_DEFAULT_SPEED=50000000
# CONFIG_SPI_FLASH_USE_4K_SECTORS is not set
CONFIG_ENV_IS_IN_SPI_FLASH=y
CONFIG_ENV_OFFSET=0x250000
CONFIG_ENV_SIZE=0x10000
CONFIG_ENV_RANGE=0x10000
CONFIG_ENV_SECT_SIZE=0x10000
CONFIG_IPQ_SPI_NOR=y
# CONFIG_DISPLAY_CPUINFO is not set
CONFIG_BOARD_EARLY_INIT_R=y
CONFIG_LZMA=y
CONFIG_ETH_MAX_MAC=2
CONFIG_ETH_MAX_UNIPHY=2
CONFIG_SYS_RX_ETH_BUFFER=128
CONFIG_TFTP_BLOCKSIZE=1280
# CONFIG_CMD_FLASH is not set
CONFIG_PHY_ANEG_TIMEOUT=100
CONFIG_OF_BOARD_FIXUP=y
# CONFIG_DDR_SI_TEST is not set
# CONFIG_LEGACY_HASHING_AND_CRYPTO is not set
# CONFIG_CMD_ELF_BOOTVX is not set
# CONFIG_SHA1_LEGACY is not set
```

## qca/feeds/bootloader/files/configs/ipq5424_mmc32_defconfig
```kconfig
CONFIG_ARM=y
CONFIG_ARCH_IPQ=y
CONFIG_ARCH_32BIT_SUPPORT=y
CONFIG_ARM_SMCCC=y
CONFIG_HAS_VBAR=y
CONFIG_SYS_BOARD="ipq5424"
CONFIG_SYS_CONFIG_NAME="ipq5424"
CONFIG_SYS_PROMPT="IPQ5424# "
CONFIG_TARGET_IPQ5424=y
CONFIG_SKIP_LOWLEVEL_INIT=y
CONFIG_NR_DRAM_BANKS=1
CONFIG_TEXT_BASE=0x8A380000
CONFIG_TEXT_SIZE=0x180000
CONFIG_SYS_LOAD_ADDR=0x90000000
CONFIG_DEVICE_TREE_INCLUDES="ipq5424-u-boot.dtsi"
CONFIG_DEFAULT_DEVICE_TREE="qcom/ipq5424-rdp466"
CONFIG_OF_LIST="qcom/ipq5424-db-mr01.1 qcom/ipq5424-rdp464-c2 qcom/ipq5424-rdp464-c3 qcom/ipq5424-rdp492 qcom/ipq5424-rdp464-qce2204 qcom/ipq5424-rdp508 qcom/ipq5424-rdp464 qcom/ipq5424-rdp466-c2 qcom/ipq5424-rdp466 qcom/ipq5424-rdp485-c2 qcom/ipq5424-rdp485 qcom/ipq5424-rdp487 qcom/ipq5424-rdp487-c3"
CONFIG_FIT=y
CONFIG_FIT_VERBOSE=y
CONFIG_BOOTDELAY=2
CONFIG_OF_BOARD_SETUP=y
CONFIG_SYS_CBSIZE=1024
# CONFIG_EFI_LOADER is not set
CONFIG_MSM_GPIO=y
CONFIG_CLK_QCOM_IPQ5424=y
CONFIG_PINCTRL_QCOM_IPQ5424=y
CONFIG_MSM_GENI_SERIAL=y
CONFIG_BOARD_EARLY_INIT_F=y
CONFIG_PINCONF=y
CONFIG_IPQ_MMC=y
CONFIG_IPQ_INLINE_ENCRYPTION=y
# CONFIG_PRPL_MMC_LABEL is not set
CONFIG_ENV_IS_IN_MMC=y
CONFIG_ENV_OVERWRITE=y
CONFIG_USE_ENV_MMC_PARTITION=y
CONFIG_SYS_MMC_ENV_PART=0
CONFIG_ENV_MMC_PARTITION="0:APPSBLENV"
CONFIG_ENV_OFFSET=0
CONFIG_ENV_SIZE=0x40000
CONFIG_ENV_RANGE=0x40000
CONFIG_FS_CRASHDUMP_ENCRYPTED=y
# CONFIG_PSCI_RESET is not set
CONFIG_USE_PREBOOT=y
CONFIG_PREBOOT="crashdump"
CONFIG_BOOTCOMMAND="bootipq"
CONFIG_BOOTARGS="console=ttyMSM0,115200n8"
# CONFIG_CMD_BOOTI is not set
# CONFIG_DISPLAY_CPUINFO is not set
CONFIG_BOARD_EARLY_INIT_R=y
CONFIG_MULTI_DTB_FIT=y
CONFIG_MULTI_DTB_FIT_LZO=y
CONFIG_SYS_MALLOC_F=y
CONFIG_SYS_MALLOC_F_LEN=0x40000
CONFIG_DTB_RESELECT=y
CONFIG_SYS_MALLOC_LEN=0xC0000
CONFIG_LZMA=y
CONFIG_SUPPORT_EMMC_BOOT=y
CONFIG_MULTI_DTB_FIT_USER_DEFINED_AREA=y
CONFIG_MULTI_DTB_FIT_USER_DEF_ADDR=0x8A500000
CONFIG_MULTI_DTB_FIT_UNCOMPRESS_SZ=0x100000
CONFIG_ETH_MAX_MAC=3
CONFIG_ETH_MAX_UNIPHY=3
CONFIG_SYS_RX_ETH_BUFFER=128
CONFIG_TFTP_BLOCKSIZE=1280
CONFIG_PHY_ANEG_TIMEOUT=100
# CONFIG_BOOTSTD is not set
# CONFIG_DDR_SI_TEST is not set
# CONFIG_LEGACY_HASHING_AND_CRYPTO is not set
# CONFIG_CMD_ELF_BOOTVX is not set
# CONFIG_SHA1_LEGACY is not set
CONFIG_COUNTER_FREQUENCY=24000000
CONFIG_USE_BOOTARGS=y
CONFIG_USE_BOOTCOMMAND=y
CONFIG_IPQ_SPI_NOR=y
# CONFIG_FDT_FIXUP_PARTITIONS is not set
```
