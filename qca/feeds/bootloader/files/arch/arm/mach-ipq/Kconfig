## qca/src/u-boot-2025/drivers/clk/qcom/Kconfig
```kconfig
if ARCH_SNAPDRAGON || ARCH_IPQ40XX || ARCH_IPQ

config CLK_QCOM
	bool
	depends on CLK && DM_RESET && POWER_DOMAIN
	def_bool n

config CLK_QCOM_PLL
	bool "Qualcomm generic PLL clock support"
	depends on CLK && DM
	help
	  Enable a generic PLL clock framework for IPQ platforms.

config CLK_QCOM_ALL
       bool "Qualcomm generic ALL clock support"
       depends on CLK && DM
       help
         Enable a generic ALL clock framework for IPQ platforms.

menu "Qualcomm clock drivers"

config CLK_QCOM_APQ8016
	bool "Qualcomm APQ8016 GCC"
	select CLK_QCOM
	help
	  Say Y here to enable support for the Global Clock Controller
	  on the Snapdragon APQ8016 SoC. This driver supports the clocks
	  and resets exposed by the GCC hardware block.

config CLK_QCOM_APQ8096
	bool "Qualcomm APQ8096 GCC"
	select CLK_QCOM
	help
	  Say Y here to enable support for the Global Clock Controller
	  on the Snapdragon APQ8096 SoC. This driver supports the clocks
	  and resets exposed by the GCC hardware block.

config CLK_QCOM_IPQ4019
	bool "Qualcomm IPQ4019 GCC"
	select CLK_QCOM
	help
	  Say Y here to enable support for the Global Clock Controller
	  on the Snapdragon IPQ4019 SoC. This driver supports the clocks
	  and resets exposed by the GCC hardware block.

config CLK_QCOM_IPQ5332
	bool "Qualcomm IPQ5332 GCC"
	select CLK_QCOM
	help
	  Say Y here to enable support for the Global Clock Controller
	  on the Snapdragon IPQ5332 SoC. This driver supports the clocks
	  and resets exposed by the GCC hardware block.

config CLK_QCOM_IPQ5424
	bool "Qualcomm IPQ5424 GCC"
	select CLK_QCOM
	help
	  Say Y here to enable support for the Global Clock Controller
	  on the Snapdragon IPQ5424 SoC. This driver supports the clocks
	  and resets exposed by the GCC hardware block.

config CLK_QCOM_NSSCC_QCE2204
	bool "Qualcomm NSSCC QCE2204"
	select CLK_QCOM
	help
	  Say Y here to enable support for the NSS Clock Controller
	  on the QCE2204. This driver supports the clocks
	  and resets exposed by the NSSCC hardware block.

config CLK_QCOM_CMN_PLL
	bool "Qualcomm CMN PLL"
	select CLK_QCOM
	help
	  Say Y here to enable support for the CMN PLL derives
	  its reference clock from the on-board Wi-Fi
	  block and supplies fixed-rate clocks to networking hardware
	  and the GCC, including PPE, external PHY or switch devices,
	  and the PCS.

config CLK_QCOM_IPQ5210
	bool "Qualcomm IPQ5210 GCC"
	select CLK_QCOM
	help
	  Say Y here to enable support for the Global Clock Controller
	  on the Snapdragon IPQ5210 SoC. This driver supports the clocks
	  and resets exposed by the GCC hardware block.

config CLK_QCOM_IPQ9650
	bool "Qualcomm IPQ9650 GCC"
	select CLK_QCOM
	help
	  Say Y here to enable support for the Global Clock Controller
	  on the Snapdragon IPQ9650 SoC. This driver supports the clocks
	  and resets exposed by the GCC hardware block.

config CLK_QCOM_IPQ9574
	bool "Qualcomm IPQ9574 GCC"
	select CLK_QCOM
	help
	  Say Y here to enable support for the Global Clock Controller
	  on the Snapdragon IPQ9574 SoC. This driver supports the clocks
	  and resets exposed by the GCC hardware block.

config CLK_QCOM_QCM2290
	bool "Qualcomm QCM2290 GCC"
	select CLK_QCOM
	help
	  Say Y here to enable support for the Global Clock Controller
	  on the Snapdragon QCM2290 SoC. This driver supports the clocks
	  and resets exposed by the GCC hardware block.

config CLK_QCOM_QCS404
	bool "Qualcomm QCS404 GCC"
	select CLK_QCOM
	help
	  Say Y here to enable support for the Global Clock Controller
	  on the Snapdragon QCS404 SoC. This driver supports the clocks
	  and resets exposed by the GCC hardware block.

config CLK_QCOM_SA8775P
	bool "Qualcomm SA8775 GCC"
	select CLK_QCOM
	help
	  Say Y here to enable support for the Global Clock Controller
	  on the Snapdragon SA8775 SoC. This driver supports the clocks
	  and resets exposed by the GCC hardware block.

config CLK_QCOM_SDM845
	bool "Qualcomm SDM845 GCC"
	select CLK_QCOM
	help
	  Say Y here to enable support for the Global Clock Controller
	  on the Snapdragon 845 SoC. This driver supports the clocks
	  and resets exposed by the GCC hardware block.

config CLK_QCOM_SM6115
	bool "Qualcomm SM6115 GCC"
	select CLK_QCOM
	help
	  Say Y here to enable support for the Global Clock Controller
	  on the Snapdragon SM6115 SoC. This driver supports the clocks
	  and resets exposed by the GCC hardware block.

config CLK_QCOM_SM8150
	bool "Qualcomm SM8150 GCC"
	select CLK_QCOM
	help
	  Say Y here to enable support for the Global Clock Controller
	  on the Snapdragon 8150 SoC. This driver supports the clocks
	  and resets exposed by the GCC hardware block.

config CLK_QCOM_SM8250
	bool "Qualcomm SM8250 GCC"
	select CLK_QCOM
	help
	  Say Y here to enable support for the Global Clock Controller
	  on the Snapdragon SM8250 SoC. This driver supports the clocks
	  and resets exposed by the GCC hardware block.

config CLK_QCOM_SM8550
	bool "Qualcomm SM8550 GCC"
	select CLK_QCOM
	help
	  Say Y here to enable support for the Global Clock Controller
	  on the Snapdragon SM8550 SoC. This driver supports the clocks
	  and resets exposed by the GCC hardware block.

config CLK_QCOM_SM8650
	bool "Qualcomm SM8650 GCC"
	select CLK_QCOM
	help
	  Say Y here to enable support for the Global Clock Controller
	  on the Snapdragon SM8650 SoC. This driver supports the clocks
	  and resets exposed by the GCC hardware block.

config CLK_QCOM_SC7280
	bool "Qualcomm SC7280 GCC"
	select CLK_QCOM
	help
	  Say Y here to enable support for the Global Clock Controller
	  on the Snapdragon SC7280 SoC. This driver supports the clocks
	  and resets exposed by the GCC hardware block.

config CLK_QCOM_X1E80100
	bool "Qualcomm X1E80100 GCC"
	select CLK_QCOM
	help
	  Say Y here to enable support for the Global Clock Controller
	  on the Snapdragon X1E80100 SoC. This driver supports the clocks
	  and resets exposed by the GCC hardware block.

endmenu

endif
```

## qca/src/u-boot-2025/fs/ext4/Kconfig
```kconfig
config FS_EXT4
	bool "Enable ext4 filesystem support"
	help
	  This provides support for reading images from the ext4 filesystem.
	  ext4 is a widely used general-purpose filesystem for Linux.
	  You can also enable CMD_EXT4 to get access to ext4 commands.

config EXT4_WRITE
	bool "Enable ext4 filesystem write support"
	depends on FS_EXT4
	help
	  This provides support for creating and writing new files to an
	  existing ext4 filesystem partition.

config FS_CRASHDUMP_ENCRYPTED
	bool "Enable crashdump filesystem hardware encryption support"
	depends on EXT4_WRITE
	help
	  This provides support for hardware-accelerated encryption during
	  crashdump file writes. When enabled, it automatically separates
	  file data (encrypted) from filesystem metadata (unencrypted) using
	  ICE (Inline Crypto Engine) hardware.
	  
	  The encryption system tracks Data Unit Numbers (DUN) for sector-level
	  encryption and provides hooks in ext4_write.c to enable/disable
	  encryption at the appropriate times.
	  
	  This is typically used in embedded systems with hardware crypto
	  acceleration for secure crashdump collection.
```
