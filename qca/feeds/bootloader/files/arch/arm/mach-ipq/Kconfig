## qca/feeds/bootloader/files/configs/ipq5424_spl_defconfig
```kconfig
CONFIG_ARM=y
CONFIG_ARCH_IPQ=y
CONFIG_ARCH_64BIT_SUPPORT=y
CONFIG_ARM_SMCCC=y
CONFIG_SYS_BOARD="ipq5424"
CONFIG_SYS_CONFIG_NAME="ipq5424"
CONFIG_TARGET_IPQ5424=y
CONFIG_NR_DRAM_BANKS=2
CONFIG_TEXT_BASE=0x8A380000
CONFIG_TEXT_SIZE=0x180000
CONFIG_SYS_LOAD_ADDR=0x90000000
CONFIG_DEFAULT_DEVICE_TREE="ipq5424-u-boot-spl"
CONFIG_OF_LIST="ipq5424-u-boot-spl"
CONFIG_MSM_GPIO=y
CONFIG_CLK_QCOM_IPQ5424=y
CONFIG_PINCTRL_QCOM_IPQ5424=y
CONFIG_MSM_GENI_SERIAL=y
CONFIG_PINCONF=y
# CONFIG_EFI_LOADER is not set
# CONFIG_PSCI_RESET is not set
# CONFIG_DISPLAY_CPUINFO is not set
# CONFIG_OF_UPSTREAM is not set
CONFIG_ETH_MAX_MAC=3
CONFIG_ETH_MAX_UNIPHY=3
CONFIG_LZMA=y
CONFIG_DTB_RESELECT=y
CONFIG_FIT=y
CONFIG_FIT_VERBOSE=y
CONFIG_MULTI_DTB_FIT=y
CONFIG_SPL=y
CONFIG_SPL_FRAMEWORK=y
CONFIG_SPL_OF_CONTROL=y
CONFIG_SPL_LIBGENERIC_SUPPORT=y
CONFIG_SPL_LIBCOMMON_SUPPORT=y
CONFIG_SPL_OF_LIBFDT=y
CONFIG_SPL_DM=y
CONFIG_SPL_GPIO=y
CONFIG_SPL_DM_GPIO=y
CONFIG_SPL_DM_RESET=y
CONFIG_SPL_PINCTRL=y
CONFIG_SPL_CLK=y
CONFIG_SPL_DRIVERS_MISC=y
CONFIG_SPL_DRIVERS_MISC_SUPPORT=y
CONFIG_SPL_SERIAL=y
CONFIG_SPL_SMEM=y
CONFIG_DM_STATS=y
CONFIG_SPL_SYS_MALLOC_F=y
CONFIG_SPL_SYS_MALLOC_F_LEN=0x20000
CONFIG_SPL_SYS_MALLOC=y
CONFIG_SYS_MALLOC_DEFAULT_TO_INIT=y
CONFIG_SPL_HAS_CUSTOM_MALLOC_START=y
CONFIG_SPL_CUSTOM_SYS_MALLOC_ADDR=0x80008000
CONFIG_SPL_SYS_MALLOC_SIZE=0x20000
# CONFIG_SPL_SEPARATE_BSS is not set
# CONFIG_SPL_USE_TINY_PRINTF is not set
CONFIG_SPL_BSS_MAX_SIZE=0x4000
CONFIG_SPL_TEXT_BASE=0x08C94000
CONFIG_SPL_TEXT_SIZE=0x4E800
CONFIG_SPL_MAX_SIZE=0x4E800
CONFIG_IPQ_MMC=y
CONFIG_SPL_MMC=y
CONFIG_SPL_MMC_SDHCI_ADMA=y
CONFIG_SPL_MMC_WRITE=y
CONFIG_SPL_SYS_MMCSD_RAW_MODE=y
CONFIG_SYS_MMCSD_RAW_MODE_U_BOOT_USE_PARTITION=y
CONFIG_SYS_MMCSD_RAW_MODE_U_BOOT_PARTITION=0x02
CONFIG_COUNTER_FREQUENCY=24000000
CONFIG_SPL_STACKPROTECTOR=y
CONFIG_SPL_LOAD_FIT=y
CONFIG_SPL_FIT_IMAGE_POST_PROCESS=y
CONFIG_SPL_ATF=y
CONFIG_SPL_ATF_LOAD_IMAGE_V2=y
CONFIG_SPL_ATF_NO_PLATFORM_PARAM=y
CONFIG_SPL_LOAD_FIT_ADDRESS=0x08CF2800
CONFIG_SPI=y
CONFIG_MSM_GENI_SPI=y
CONFIG_DM_SPI=y
CONFIG_IPQ_SPI_NOR=y
CONFIG_SPL_SPI_FLASH_MTD=y
CONFIG_SPL_SPI=y
CONFIG_SPL_DM_SPI=y
CONFIG_SPL_SPI_FLASH=y
CONFIG_SPL_SPI_FLASH_SUPPORT=y
CONFIG_SPL_SPI_LOAD=y
CONFIG_SPL_SPI_SUPPORT=y
CONFIG_SF_DEFAULT_BUS=0
CONFIG_SF_DEFAULT_CS=0
CONFIG_SF_DEFAULT_MODE=0x0
CONFIG_SF_DEFAULT_SPEED=50000000
CONFIG_DM_SPI_FLASH=y
CONFIG_SPL_DM_SPI_FLASH=y
CONFIG_SPI_FLASH=y
CONFIG_SPL_MTD=y
CONFIG_SPL_DM_MAILBOX=y
CONFIG_OF_SPL_REMOVE_PROPS=""
CONFIG_SHARED_IPC_INTERRUPT_REG=0xF400008
CONFIG_IPQ_TMEL_IPC_SUPPORT=y
CONFIG_MTD_RAW_NAND=y
CONFIG_SPL_MTD_RAW_NAND=y
CONFIG_SYS_NAND_SELF_INIT=y
CONFIG_SPL_SYS_NAND_SELF_INIT=y
CONFIG_NAND_QTI=y
CONFIG_SPL_NAND_QTI=y
CONFIG_IPQ_NAND=y
CONFIG_SPL_NAND_SUPPORT=y
CONFIG_SPL_NAND_DRIVERS=y
CONFIG_SPL_NAND_ECC=y
CONFIG_SPL_NAND_BASE=y
CONFIG_SPL_NAND_INIT=y
CONFIG_SPL_NAND_IDENT=y
CONFIG_DMA=y
CONFIG_BAM_DMA=y
CONFIG_DMA_CHANNELS=y
CONFIG_SPL_DMA=y
CONFIG_SPL_BAM_DMA=y
CONFIG_SPL_DMA_CHANNELS=y
CONFIG_SYS_NAND_U_BOOT_LOCATIONS=y
CONFIG_SYS_NAND_U_BOOT_OFFS=0xA00000
CONFIG_SYS_NAND_BLOCK_SIZE=0x20000
CONFIG_CLK_QCOM_PLL=y
CONFIG_SPL_REMAKE_ELF=y
```

## qca/feeds/bootloader/files/drivers/net/qcom/Kconfig
```kconfig
config ETH_IPQ5332
	depends on DM && QCOM_NSS_SWITCH && TARGET_IPQ5332
	default y
	bool "Ethernet driver for QCOM IPQ5332"
	help
	  Enable this to support the ethernet in IPQ5332 SoCs.

config ETH_IPQ9574
	depends on DM && QCOM_NSS_SWITCH && TARGET_IPQ9574
	default y
	bool "Ethernet driver for QCOM IPQ9574"
	help
	  Enable this to support the ethernet in QCOM IPQ9574 Soc.

config ETH_IPQ5424
	depends on DM && QCOM_NSS_SWITCH && TARGET_IPQ5424
	default y
	bool "Ethernet driver for QCOM IPQ5424"
	help
	  Enable this to support the ethernet in QCOM IPQ5424 Soc.

config ETH_LOW_MEM
	depends on DM && QCOM_NSS_SWITCH
	default n
	bool "Enable low memory configuration on IPQ ethernet driver"
	help
	  Enable low memory configuration on IPQ SoC ethernet driver

config QCOM_NSS_SWITCH_V2
	depends on DM
	default n
	bool "Enable NSS version 2 driver"
	help
	  Enable the NSS version 2 driver for IPQ SoC Ethernet support.


config NSS_PPE_V4
	depends on DM && QCOM_NSS_SWITCH_V2
	default n
	bool "Enable PPE V4 support in NSS driver"
	help
	  Enable PPE V4 support in NSS driver

config ETH_IPQ5210
	depends on DM && QCOM_NSS_SWITCH_V2 && TARGET_IPQ5210 && NSS_PPE_V4
	default y
	bool "Ethernet driver for QCOM IPQ5210"
	help
	  Enable this to support the ethernet in QCOM IPQ5210 Soc.

config ETH_IPQ9650
	depends on DM && QCOM_NSS_SWITCH_V2 && TARGET_IPQ9650 && NSS_PPE_V4
	default y
	bool "Ethernet driver for QCOM IPQ9650"
	help
	  Enable this to support the ethernet in QCOM IPQ9650 Soc.
```

## qca/feeds/opensync/opensync/Config.in
```kconfig
menu "OpenSync configuration"
	depends on PACKAGE_opensync

config OPENSYNC_TARGET
    string "OpenSync target specifier"
    default ""

config OPENSYNC_NL_SUPPORT
	bool "OpenSync enable NL support"
	default y

config OPENSYNC_ONBOARD_SSID
	string "OpenSync onboarding network SSID"
	default "none"

config OPENSYNC_ONBOARD_PSK
	string "OpenSync onboarding network PSK"
	default "none"

config OPENSYNC_SRC
    string "OpenSync local source code path"
    default ""

config OPENSYNC_SUPPORTED
    bool "OpenSync config to enable Opensync-patches"
    default y

endmenu
```

## qca/feeds/qca-rptr-mgr/qca-rptr-mgr/Config.in
```kconfig
# iface configs
config IFACE_SUPPORT_CFG80211
        bool "Support cfg80211 config layer for RPTR mgr"
        depends on PACKAGE_qca-cfg80211
        default y
        help
          CFG80211 support for RPTR manager
```

## qca/src/linux-6.6/arch/arm/mach-qcom/Kconfig
```kconfig
# SPDX-License-Identifier: GPL-2.0-only
menuconfig ARCH_QCOM
	bool "Qualcomm Support"
	depends on ARCH_MULTI_V7
	select ARM_GIC
	select ARM_AMBA if IPQ_MEM_PROFILE != 256
	select PINCTRL
	select QCOM_SCM if SMP
	select ARM_GIC_V2M if PCI
	help
	  Support for Qualcomm's devicetree based systems.

if ARCH_QCOM

config ARCH_IPQ40XX
	bool "Enable support for IPQ40XX"
	select CLKSRC_QCOM
	select HAVE_ARM_ARCH_TIMER

config ARCH_IPQ5424
	bool "Enable support for IPQ5424"
	select ARM_GIC_V3

config ARCH_IPQ9650
	bool "Enable support for IPQ9650"
	select ARM_GIC_V3

config ARCH_MSM8X60
	bool "Enable support for MSM8X60"
	select CLKSRC_QCOM

config ARCH_MSM8909
	bool "Enable support for MSM8909"
	select HAVE_ARM_ARCH_TIMER

config ARCH_MSM8916
	bool "Enable support for MSM8916"
	select HAVE_ARM_ARCH_TIMER
	help
	  Enable support for the Qualcomm Snapdragon 410 (MSM8916/APQ8016).

	  Note that ARM64 is the main supported architecture for MSM8916.
	  The ARM32 option is intended for a few devices with signed firmware
	  that does not allow booting ARM64 kernels.

config ARCH_MSM8960
	bool "Enable support for MSM8960"
	select CLKSRC_QCOM

config ARCH_MSM8974
	bool "Enable support for MSM8974"
	select HAVE_ARM_ARCH_TIMER

config ARCH_MDM9615
	bool "Enable support for MDM9615"
	select CLKSRC_QCOM

config IPQ_MEM_PROFILE
	int "Select Memory Profile"
	range 0 1024
	default 0
	help
	  This option select memory profile to be used, which defines
	  the reserved memory configuration used in device tree.

	  If unsure, say 0

config SKB_FIXED_SIZE_2K
	bool "SKB size fixed at 2K"
	default n
	help
	  This is a hint to the NSS driver that the ‘skbuff’ size might
	  need to be fixed at 2KB, to conserve memory.

config IO_COHERENCY
	bool "Enable IO Coherency for kernel modules"
	default n
	help
	  Enable/Disable IO Coherency for kernel modules.

config IPQ_PROFILE_MINENT
	bool "Select minent build profile"
	default n
	help
	  Enable/Disable MINENT profile. Based on this UBI is enabled
	  or disabled in device tree.

config IPQ_PON
	bool "Enable PON config"
	default n
	help
	 This is a hint to the NSS-DP and PON driver that the PON
	 is enabled in the build.
endif
```

## qca/src/linux-6.6/drivers/bus/mhi/Kconfig
```kconfig
# SPDX-License-Identifier: GPL-2.0
#
# MHI bus
#
# Copyright (c) 2021, Linaro Ltd.
#

config MHI_BUS_TEST
	tristate "MHI bus Test driver"
	depends on MHI_BUS
	help
	  Test driver for testing the MHI bus

source "drivers/bus/mhi/host/Kconfig"
source "drivers/bus/mhi/ep/Kconfig"
source "drivers/bus/mhi/clients/Kconfig"
```
