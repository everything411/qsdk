## qca/feeds/optic-drivers-oss/omciibc/Config.in
```kconfig
if PACKAGE_omciibc

config OMCIIBC_SWHOOK_ENABLE
	bool "enable omciibc swhook feature"
	default n

endif
```

## qca/feeds/platform_utils/libbbfdm/Config.in
```kconfig
if PACKAGE_libbbfdm

config BBF_VENDOR_EXTENSION
	bool "Enable Vendor Extension"
	default y

config BBF_VENDOR_LIST
	string "Vendor List"
	default "openwrt"

config BBF_VENDOR_PREFIX
	string "Vendor Prefix"
	default "X_IOPSYS_EU_"

config BBF_TR181
	bool "Enable TR-181 Data Model Support"
	default y

config BBF_TR104
	bool "Enable TR-104 Data Model Support"
	default y

config BBF_TR143
	bool "Enable TR-143 Data Model Support"
	default y

endif
```

## qca/src/recipes-qcawifi-oss/conf/layer.conf
```bitbake
BBFILES += "${LAYERDIR}/recipes/*/*.bb ${LAYERDIR}/recipes/*/*/*.bb ${LAYERDIR}/recipes/*/*.bbappend ${LAYERDIR}/recipes-products/images/*.bbappend ${LAYERDIR}/recipes-support/*/*.bb ${LAYERDIR}/recipes-support/*/*.bbappend"
BBPATH .= ":${LAYERDIR}"
BBFILE_COLLECTIONS += "qti-ipq-oss"
BBFILE_PRIORITY_qti-ipq-oss = "17"
BBFILE_PATTERN_qti-ipq-oss := "^${LAYERDIR}/"

LAYERSERIES_COMPAT_qti-ipq-oss = "thud dunfell"
```

## qca/src/u-boot/board/qti/common/Kconfig
```kconfig
config IPQ_CRASHDUMP
	bool "IPQ Crashdump collection support"
	depends on USE_PREBOOT
	default n

config IPQ_MINIDUMP
	bool "IPQ Minidump collection support"
	depends on IPQ_CRASHDUMP
	default n

config IPQ_COMPRESSED_CRASHDUMP
	bool "IPQ Compressed (GZIP) Crashdump support"
	depends on IPQ_CRASHDUMP
	select CMD_ZIP
	default n

config IPQ_CRASHDUMP_TO_USB
	bool "IPQ Collect Crashdump over USB"
	depends on IPQ_CRASHDUMP && IPQ_USB
	default n

config IPQ_CRASHDUMP_TO_MEMORY
	bool "IPQ Collect Crashdump over DDR Memory"
	depends on IPQ_CRASHDUMP
	default n

config IPQ_CRASHDUMP_TO_NVMEMORY
	bool "IPQ Collect Crashdump over Non-Volatile Memory (eMMC / NAND)"
	depends on IPQ_CRASHDUMP
	default n

config IPQ_CRASHDUMP_TO_FLASH
	bool "IPQ Collect Crashdump over FLASH"
	depends on IPQ_CRASHDUMP && IPQ_MINIDUMP
	default n

config IPQ_CRASHDUMP_TO_EMMC
	bool "IPQ Collect Crashdump over EMMC"
	depends on IPQ_CRASHDUMP && IPQ_COMPRESSED_CRASHDUMP && IPQ_MMC
	imply CMD_EXT4
	imply CMD_EXT4_WRITE
	default n

config IPQ_FLUTILS
	bool "IPQ Flash Utility support"
	default n

config IPQ_FDT_FIXUP
	bool "IPQ FDT Fixup support"
	default n
```

## qca/src/u-boot/board/qti/ipq5332/Kconfig
```kconfig
if TARGET_IPQ5332

config SYS_BOARD
	default "ipq5332"

config SYS_VENDOR
	default "qti"

config SYS_SOC
	default "ipq5332"

config SYS_CONFIG_NAME
	default "ipq5332"

endif
```

## qca/src/u-boot/board/qti/ipq5424/Kconfig
```kconfig
if TARGET_IPQ5424

config SYS_BOARD
	default "ipq5424"

config SYS_VENDOR
	default "qti"

config SYS_SOC
	default "ipq5424"

config SYS_CONFIG_NAME
	default "ipq5424"

endif
```

## qca/src/u-boot/board/qti/ipq9574/Kconfig
```kconfig
if TARGET_IPQ9574

config SYS_BOARD
	default "ipq9574"

config SYS_VENDOR
	default "qti"

config SYS_SOC
	default "ipq9574"

config SYS_CONFIG_NAME
	default "ipq9574"

endif
```

## qca/src/u-boot/drivers/clk/qti/Kconfig
```kconfig
config CLK_IPQ5332
	depends on DM && PINCTRL_QTI && TARGET_IPQ5332
	default y
	bool "Clock controller driver for QTI IPQ5332"
	help
	  Enable this to support the clocks on IPQ5332 SoCs.

config CLK_IPQ9574
	depends on DM && PINCTRL_QTI && TARGET_IPQ9574
	default y
	bool "Clock controller driver for QTI IPQ9574"
	help
	  Enable this to support the clocks on QTI IPQ9574 Soc.

config CLK_IPQ5424
	depends on DM && PINCTRL_QTI && TARGET_IPQ5424
	default y
	bool "Clock controller driver for QTI IPQ5424"
	help
	  Enable this to support the clocks on IPQ5424 Soc.
```

## qca/src/u-boot/drivers/net/qti/Kconfig
```kconfig
config ETH_IPQ5332
	depends on DM && QTI_NSS_SWITCH && TARGET_IPQ5332
	default y
	bool "Ethernet driver for QTI IPQ5332"
	help
	  Enable this to support the ethernet in IPQ5332 SoCs.

config ETH_IPQ9574
	depends on DM && QTI_NSS_SWITCH && TARGET_IPQ9574
	default y
	bool "Ethernet driver for QTI IPQ9574"
	help
	  Enable this to support the ethernet in QTI IPQ9574 Soc.

config ETH_IPQ5424
	depends on DM && QTI_NSS_SWITCH && TARGET_IPQ5424
	default y
	bool "Ethernet driver for QTI IPQ5424"
	help
	  Enable this to support the ethernet in QTI IPQ5424 Soc.

config ETH_LOW_MEM
	depends on DM && QTI_NSS_SWITCH
	default n
	bool "Enable low memory configuration on IPQ ethernet driver"
	help
	  Enable low memory configuration on IPQ SoC ethernet driver
```

## qca/src/u-boot/drivers/pinctrl/qti/Kconfig
```kconfig
config PINCTRL_IPQ5332
	depends on DM && PINCTRL_QTI && TARGET_IPQ5332
	default y
	select PINCONF
	bool "QTI IPQ5332 pin control driver"
	help
	  Supports pin multiplexing control on IPQ5332 SoCs.

	  The driver is controlled by a device tree node which contains both
	  the GPIO definitions and pin control functions for each available
	  multiplex function.

config PINCTRL_IPQ9574
	depends on DM && PINCTRL_QTI && TARGET_IPQ9574
	default y
	select PINCONF
	bool "QTI IPQ9574 pin control driver"
	help
	  Supports pin multiplexing control on IPQ9574 SoCs.

	  The driver is controlled by a device tree node which contains both
	  the GPIO definitions and pin control functions for each available
	  multiplex function.

config PINCTRL_IPQ5424
	depends on DM && PINCTRL_QTI && TARGET_IPQ5424
	default y
	select PINCONF
	bool "QTI IPQ5424 pin control driver"
	help
	  Supports pin multiplexing control on IPQ5424 SoCs.

	  The driver is controlled by a device tree node which contains both
	  the GPIO definitions and pin control functions for each available
	  multiplex function.
```
